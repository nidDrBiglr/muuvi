## CMakeLists.txt
```
cmake_minimum_required(VERSION 3.20.0)

find_package(Zephyr REQUIRED HINTS $ENV{ZEPHYR_BASE})

project(muuvi)

# Include files that are common for all modules
add_subdirectory(src/common)

# Include mandatory module source folders
add_subdirectory(src/modules/ble)
add_subdirectory(src/modules/error)
add_subdirectory(src/modules/led)
add_subdirectory(src/modules/sensing)
add_subdirectory(src/modules/trigger)
```

## Kconfig
```
menu "Muuvi"

rsource "src/modules/ble/Kconfig.ble"
rsource "src/modules/led/Kconfig.led"
rsource "src/modules/error/Kconfig.error"
rsource "src/modules/sensing/Kconfig.sensing"
rsource "src/modules/trigger/Kconfig.trigger"

endmenu

module=MUUVI
module-dep=LOG
module-str=nrf52840dongle Ruuvi Firmware

source "${ZEPHYR_BASE}/subsys/logging/Kconfig.template.log_config"

menu "Zephyr Kernel"
source "Kconfig.zephyr"
endmenu
```

## prj.conf
```kconfig
# BLE
CONFIG_BT=y # enable bluetooth library
CONFIG_BT_PERIPHERAL=y # use the device as a broadcaster (non-connectable)
CONFIG_BT_CTLR_TX_PWR_0=y # set ble tx power
CONFIG_BT_DEVICE_NAME="Muuvi" # aka Mock Ruuvi
CONFIG_BT_HCI_ERR_TO_STR=y # enable hci error code to string representation

# Enable Nordic UART Service (NUS)
CONFIG_BT_NUS=y

# GPIO
CONFIG_GPIO=y # GPIO for sensors and LEDs

# Sensor libraries
CONFIG_SENSOR=y
CONFIG_DHT=y

# zbus
CONFIG_ZBUS=y
CONFIG_ZBUS_LOG_LEVEL_INF=y
CONFIG_ZBUS_CHANNEL_NAME=y
CONFIG_ZBUS_OBSERVER_NAME=y
CONFIG_ZBUS_MSG_SUBSCRIBER=y
CONFIG_HEAP_MEM_POOL_SIZE=1024
CONFIG_ZBUS_MSG_SUBSCRIBER_NET_BUF_POOL_SIZE=32

# PWM
CONFIG_PWM=y # PWM for the rgb led

# Utils
CONFIG_FPU=y # print floats
CONFIG_LOG=y # enable config library
CONFIG_REBOOT=y # enable reboot
CONFIG_RESET_ON_FATAL_ERROR=n # reset the device on unrecoverable errors
```

## boards/nrf52840dongle_nrf52840.overlay
```dts
/ {
    dht22 {
		compatible = "aosong,dht";
		status = "okay";
		friendly-name = "DHT22";
		dio-gpios = <&gpio0 10 (GPIO_PULL_UP | GPIO_ACTIVE_LOW)>;
		dht22;
	};

};
```

## src/main.c
```c
#include <zephyr/logging/log.h>

#include "ble.h"
#include "led.h"

LOG_MODULE_REGISTER(main);

int main(void)
{
	LOG_INF("---- starting Ruuvi for nrf52840dongle ----");

	init_leds();

	init_sensors();

	init_ble();

	return 0;
}
```

## src/ble.c
```c
#include "ble.h"

LOG_MODULE_REGISTER(ble);

// see https://docs.ruuvi.com/communication/bluetooth-advertisements/data-format-5-rawv2
// all payload values are initialized with their "not available" values
static uint8_t mfg_data[] = {
	// Company identifier (Ruuvi Innovations Ltd - 0x0499)
	0x99, 0x04,
	// Data format 5 (RAWv2)
	0x05,
	// Temperature in 0.005 degree steps
	// valid values: -32767 ... 32767, "not available": 0x8000
	0x80, 0x00,
	// Humidity (16bit unsigned) in 0.0025% steps (0-163.83% range, though realistically 0-100%)
	// valid values: 0 ... 40000, "not available": 0xFFFF
	0xFF, 0xFF,
	// Atmospheric pressure (16bit unsigned) in 1 Pa units, with offset of -50 000 Pa
	// valid values: 0 ... 65534, "not available": 0xFFFF
	0xFF, 0xFF,
	// Acceleration-X (Most Significant Byte first)
	// valid values: -32767 ... 32767, "not available": 0x8000
	0x80, 0x00,
	// Acceleration-Y (Most Significant Byte first)
	// valid values: -32767 ... 32767, "not available": 0x8000
	0x80, 0x00,
	// Acceleration-Z (Most Significant Byte first)
	// valid values: -32767 ... 32767, "not available": 0x8000
	0x80, 0x00,
	// Power info (11+5bit unsigned)
	// First 11 bits is the battery voltage above 1.6V, in millivolts (1.6V to 3.646V range)
	// Last 5 bits unsigned are the TX power above -40dBm - +20dB,, in 2dBm steps.
	// valid values: 0 ... 2046 and 0 ... 30 respectively
	// statically set to 3.3V, since its powered by USB
	// 3.3V = 1700 = 11010100100, +0dBm = 20 = 10100 => 1101010010010100_b = 0xD494_h
	0xD4, 0x94, // static
	// Movement counter (8 bit unsigned), incremented by motion detection interrupts from
	// accelerometer
	// valie values: 0 ... 254, "not available": 0xFF
	0xFF, // unused
	// Measurement sequence number (16 bit unsigned), each time a measurement is taken, this is
	// incremented by one, used for measurement de-duplication.
	// Depending on the transmit interval, multiple packets with the same measurements can be
	// sent, and there may be measurements that never were sent.
	// valid values: 0 ... 65534, "not available": 0xFFFF
	0xFF, 0xFF, // incremented each time a measurement is recorded
	// any valid MAC address
	// will be dynamically set by the firmware after the BLE module is initialized
	0x00, 0x00, 0x00, 0x00, 0x00, 0x00};

// advertisement parameters
static const struct bt_le_adv_param adv_params = {
	.id = BT_ID_DEFAULT,
	.options = BT_LE_ADV_OPT_CONNECTABLE,        // advertise as connectable
	.interval_min = BT_GAP_PER_ADV_SLOW_INT_MIN, // 1s
	.interval_max = BT_GAP_PER_ADV_SLOW_INT_MAX, // 1.2s
	.peer = NULL,
};

// client connected callback
static void connected(struct bt_conn *conn, uint8_t err)
{
	if (err) {
		LOG_ERR("Connection failed, error: 0x%02x %s", err, bt_hci_err_to_str(err));
		set_led_pattern(&PATTERN_BLE_CONNECTION_FAILED);
		return;
	}

	set_led_pattern(&PATTERN_BLE_CONNECTED);

	struct bt_conn_info info;
	if (bt_conn_get_info(conn, &info)) {
		LOG_ERR("Connected to unknown device");
		return;
	}

	char addr_str[BT_ADDR_LE_STR_LEN];
	bt_addr_le_to_str_without_type(info.le.dst, addr_str, sizeof(addr_str));

	LOG_INF("Connected to device '%s'", addr_str);
}

// client disconnected callback
static void disconnected(struct bt_conn *conn, uint8_t reason)
{
	set_led_pattern(&PATTERN_BLE_DISCONNECTED);

	struct bt_conn_info info;
	if (bt_conn_get_info(conn, &info)) {
		LOG_INF("Device disconnected, reason: 0x%02x %s", reason,
			bt_hci_err_to_str(reason));
		return;
	}

	char addr_str[BT_ADDR_LE_STR_LEN];
	bt_addr_le_to_str_without_type(info.le.dst, addr_str, sizeof(addr_str));

	LOG_INF("Device '%s' disconnected, reason: 0x%02x %s", addr_str, reason,
		bt_hci_err_to_str(reason));
}

// advertisement data
static const struct bt_data ad[] = {
	BT_DATA(BT_DATA_MANUFACTURER_DATA, mfg_data, sizeof(mfg_data)) // measurements
};

// scan response data
static char device_name[DEVICE_NAME_MAX_LEN];
static struct bt_data sd[] = {
	BT_DATA(BT_DATA_NAME_COMPLETE, device_name, 0), // device name, set dynamically
	BT_DATA(BT_DATA_TX_POWER, "\x00", 1),           // tx power level (+0dBm), static
};

// sequence number, will be updated whenever a new measurement is recorded
// set initial value to 65535 to indicate "not available" if, for some reason, the sequence number
// is not updated
static uint16_t sequence_number = 65535;

// boolean to indicate advertising state
static bool is_advertising = false;

void update_advertisement_data(uint8_t *mfg_data)
{
	LOG_INF("collecting measurements...");
	// turn on the green channel of the LED to indicate measurement collecting
	set_led_pattern(&PATTERN_COLLECTING_SENSOR);
	k_sleep(K_SECONDS(2));
	// get temperature value
	measurement_t measurements;
	read_sensor_values(&measurements);
	// update temperature in advertisement data
	mfg_data[3] = (measurements.temperature >> 8) & 0xFF;
	mfg_data[4] = measurements.temperature & 0xFF;
	// update humidity in advertisement data
	mfg_data[5] = (measurements.humidity >> 8) & 0xFF;
	mfg_data[6] = measurements.humidity & 0xFF;
	// update sequence number in advertisement data
	sequence_number++;
	// reset sequence number if its > 65534, as the max allowed value is 65534
	// 65535 is reserved for "not available"
	if (sequence_number > 65534) {
		// reset sequence number, if greater than allowed value
		// sequence number will be reset every ~23 days with advertisements every 30 seconds
		sequence_number = 0;
	}
	mfg_data[18] = (sequence_number >> 8) & 0xFF;
	mfg_data[19] = sequence_number & 0xFF;

	LOG_INF("updated advertising values: temperature: %f, humidity: %f",
		measurements.temperature * 0.005, measurements.humidity * 0.0025);
}

void init_ble()
{
	int err;
	LOG_INF("initializing BLE module...");
	err = bt_enable(NULL);
	if (err) {
		set_led_pattern(&PATTERN_BLE_INIT_FAILED);
		LOG_ERR("BLE init failed, err %d", err);
		return;
	}

	// register connection callbacks
	struct bt_conn_cb conn_callbacks = {
		.connected = connected,
		.disconnected = disconnected,
	};
	bt_conn_cb_register(&conn_callbacks);
	// init gatt services
	init_gatt_services();

	// dynamically set the BLE MAC address of the dongle in the payload
	bt_addr_le_t addr;
	size_t count = 1;
	bt_id_get(&addr, &count);
	// set mac address of payload bytes 20 - 25 from addr.a (neds to be in reverse order)
	for (int i = 0; i < 6; i++) {
		mfg_data[20 + i] = addr.a.val[5 - i];
	}
	// set the device name and append the last 2 bytes of the MAC address to the name
	snprintf(device_name, sizeof(device_name), "%s %02X%02X", CONFIG_BT_DEVICE_NAME,
		 addr.a.val[1], addr.a.val[0]);
	// update the length of the device name scan response
	sd[0].data_len = strlen(device_name);
	LOG_INF("visible as '%s' with address '%02X:%02X:%02X:%02X:%02X:%02X'", device_name,
		addr.a.val[5], addr.a.val[4], addr.a.val[3], addr.a.val[2], addr.a.val[1],
		addr.a.val[0]);

	LOG_INF("BLE initialized, starting advertisement cycle...");
	while (true) {
		// stop advertising before updating the data
		if (is_advertising) {
			LOG_INF("stopping advertising sequence %d...", sequence_number);
			bt_le_adv_stop();
			is_advertising = false;
		}
		// update the advertisement data
		update_advertisement_data(mfg_data);
		// restart advertising with updated data
		err = bt_le_adv_start(&adv_params, ad, ARRAY_SIZE(ad), sd, ARRAY_SIZE(sd));
		if (err) {
			set_led_pattern(&PATTERN_BLE_ADVERTISING_FAILED);
			LOG_ERR("advertisement failed to start, err %d", err);
			return;
		}
		is_advertising = true;
		set_led_pattern(&PATTERN_BLE_ADVERTISING);
		LOG_INF("advertising sequence %d started...", sequence_number);
		// sleep until next measurement interval
		k_sleep(MEASUREMENT_INTERVAL);
	}
}
```

## src/ble.h
```c
#ifndef BLE_H
#define BLE_H

#include <zephyr/types.h>
#include <zephyr/kernel.h>
#include <zephyr/sys/util.h>
#include <zephyr/logging/log.h>
#include <zephyr/bluetooth/hci.h>
#include <zephyr/bluetooth/conn.h>
#include <zephyr/bluetooth/bluetooth.h>

#include <stdio.h>
#include <stddef.h>
#include <stdlib.h>
#include <stdbool.h>
#include <autoconf.h>

#include "gatt.h"
#include "led.h"
#include "sensors.h"
#include "utils.h"

#define MEASUREMENT_INTERVAL K_SECONDS(30)
#define DEVICE_NAME_MAX_LEN  50

void init_ble();

#endif // BLE_H
```

## src/gatt.c
```c
#include "gatt.h"

LOG_MODULE_REGISTER(gatt);

// NUS RX callback handler
static void nus_rx_cb(struct bt_conn *conn, const uint8_t *const data, uint16_t len)
{
	char client_addr[BT_ADDR_LE_STR_LEN];
	bt_addr_le_t addr;
	bt_addr_le_copy(&addr, bt_conn_get_dst(conn));
	bt_addr_le_to_str(&addr, client_addr, sizeof(client_addr));
	set_led_pattern(&PATTERN_NUS_RX_RECEIVED);

	LOG_INF("NUS RX: received '%s' from '%s'", data, client_addr);
}

void init_gatt_services(void)
{
	// NUS is required according to ruuvi specs to fully mock the behaviour
	// see https://docs.ruuvi.com/communication/bluetooth-connection/nordic-uart-service-nus
	struct bt_nus_cb nus_cb = {
		.received = nus_rx_cb,
	};
	bt_nus_init(&nus_cb);
}
```

## src/gatt.h
```c
#ifndef GATT_H
#define GATT_H

#include <zephyr/logging/log.h>
#include <zephyr/bluetooth/gatt.h>
#include <bluetooth/services/nus.h>
#include <zephyr/bluetooth/bluetooth.h>

#include "led.h"

void init_gatt_services(void);

#endif // GATT_H
```

## src/gatt_services.c
```c
#include "gatt_services.h"

LOG_MODULE_REGISTER(gatt);

// NUS RX callback handler
static void nus_rx_cb(struct bt_conn *conn, const uint8_t *const data, uint16_t len)
{
	char client_addr[BT_ADDR_LE_STR_LEN];
	bt_addr_le_t addr;
	bt_addr_le_copy(&addr, bt_conn_get_dst(conn));
	bt_addr_le_to_str(&addr, client_addr, sizeof(client_addr));
	set_led_pattern(&PATTERN_NUS_RX_RECEIVED);

	LOG_INF("NUS RX: received '%s' from '%s'", data, client_addr);
}

void init_gatt_services(void)
{
	// NUS is required according to ruuvi specs to fully mock the behaviour
	// see https://docs.ruuvi.com/communication/bluetooth-connection/nordic-uart-service-nus
	struct bt_nus_cb nus_cb = {
		.received = nus_rx_cb,
	};
	bt_nus_init(&nus_cb);
}
```

## src/gatt_services.h
```c
#ifndef GATT_SERVICES_H
#define GATT_SERVICES_H

#include <zephyr/logging/log.h>
#include <zephyr/bluetooth/gatt.h>
#include <bluetooth/services/nus.h>
#include <zephyr/bluetooth/bluetooth.h>

#include "led.h"

void init_gatt_services(void);

#endif // GATT_SERVICES_H
```

## src/led.c
```c
#include "led.h"

LOG_MODULE_REGISTER(led_ctrl);

// GPIO LEDs
static const struct gpio_dt_spec led_1 = GPIO_DT_SPEC_GET(DT_ALIAS(led0), gpios);
static const struct gpio_dt_spec *gpio_leds[] = {&led_1};
static size_t number_of_gpio_leds = sizeof(gpio_leds) / sizeof(gpio_leds[0]);
// PWM LEDs
static const struct pwm_dt_spec red_pwm_led = PWM_DT_SPEC_GET(DT_ALIAS(red_pwm_led));
static const struct pwm_dt_spec green_pwm_led = PWM_DT_SPEC_GET(DT_ALIAS(green_pwm_led));
static const struct pwm_dt_spec blue_pwm_led = PWM_DT_SPEC_GET(DT_ALIAS(blue_pwm_led));
static const struct pwm_dt_spec *pwm_leds[] = {&red_pwm_led, &green_pwm_led, &blue_pwm_led};
static size_t number_of_pwm_leds = sizeof(pwm_leds) / sizeof(pwm_leds[0]);
// current pattern and step
static const led_pattern_t *current_pattern = NULL;
static int pattern_step = 0;
// timer object to handle pulsing
static struct k_timer led_timer;
// indicator whether leds have been initialized
static bool leds_initialized = false;

// utility function to set RGB values
void set_rgb(uint32_t r, uint32_t g, uint32_t b)
{
	pwm_set_pulse_dt(&red_pwm_led, r);
	pwm_set_pulse_dt(&green_pwm_led, g);
	pwm_set_pulse_dt(&blue_pwm_led, b);
}

// utility functions to turn off the LEDs
void pwm_off()
{
	set_rgb(0, 0, 0);
}

void gpio_off()
{
	gpio_pin_set_dt(&led_1, false);
}

void all_off()
{
	pwm_off();
	gpio_off();
}

// handle timer events, stops the timer if the pattern has finished
void led_timer_handler(struct k_timer *timer)
{
	if (current_pattern && current_pattern->step_fn) {
		bool running = current_pattern->step_fn(&pattern_step);
		if (!running) {
			k_timer_stop(&led_timer);
		}
	}
}

// sets and triggers the given led pattern
void set_led_pattern(const led_pattern_t *pattern)
{
	if (leds_initialized) {
		current_pattern = pattern;
		pattern_step = 0;

		if (pattern) {
			LOG_INF("activating LED Pattern %s", pattern->name);
			k_timer_start(&led_timer, K_NO_WAIT, K_MSEC(100));
		} else {
			LOG_INF("turning all LEDs off");
			k_timer_stop(&led_timer);
			all_off();
		}
	} else {
		LOG_WRN("some of the GPIO or PWM LEDs could not be initialized, ignoring...");
	}
}

void init_leds(void)
{
	LOG_INF("initializing GPIO %d LEDs...", number_of_gpio_leds);
	for (int i = 0; i < number_of_gpio_leds; i++) {
		if (device_is_ready(gpio_leds[i]->port)) {
			if (gpio_pin_configure_dt(gpio_leds[i], GPIO_OUTPUT_INACTIVE)) {
				LOG_WRN("GPIO led%d could not be configured", i);
				return;
			}
		} else {
			LOG_WRN("GPIO led%d is not ready, aborting...", i);
			return;
		}
	}
	LOG_INF("GPIO LEDs initialized, checking readiness of %d PWM LEDs...", number_of_pwm_leds);
	for (int i = 0; i < number_of_pwm_leds; i++) {
		if (!pwm_is_ready_dt(pwm_leds[i])) {
			LOG_WRN("PWM led%d is not ready, aborting...", i);
			return;
		}
	}
	LOG_INF("All %d PWM LEDs are ready", number_of_pwm_leds);
	leds_initialized = true;

	// initialize the timer to handle PWM pulsing
	k_timer_init(&led_timer, led_timer_handler, NULL);
}

// error pattern for BLE init failure
bool pattern_ble_init_failed_step(int *step)
{
	switch (*step) {
	case 0:
		set_rgb(PWM_PERIOD_USEC, 0, 0);
		break;
	case 20:
		pwm_off();
		break;
	case 70:
		*step = -1;
		break;
	}
	(*step)++;
	return true;
}

const led_pattern_t PATTERN_BLE_INIT_FAILED = {
	.name = "BLE Init Failed",
	.step_fn = pattern_ble_init_failed_step,
};

// error pattern for ble advertising failure
bool pattern_ble_advertising_failed_step(int *step)
{
	switch (*step) {
	case 0:
	case 4:
		set_rgb(PWM_PERIOD_USEC, 0, 0); // red blink
		break;
	case 2:
	case 6:
		pwm_off();
		break;
	case 20:
		*step = -1; // reset after pause
		break;
	}
	(*step)++;
	return true;
}

const led_pattern_t PATTERN_BLE_ADVERTISING_FAILED = {
	.name = "BLE Advertising Failed",
	.step_fn = pattern_ble_advertising_failed_step,
};

// pattern for collecting sensor data
bool pattern_collecting_sensor_step(int *step)
{
	if (*step % 10 < 5) {
		set_rgb(PWM_PERIOD_USEC, PWM_PERIOD_USEC, 0); // yellow on
	} else {
		pwm_off();
	}
	(*step)++;
	return true;
}

const led_pattern_t PATTERN_COLLECTING_SENSOR = {
	.name = "Collecting Sensor Measurements",
	.step_fn = pattern_collecting_sensor_step,
};

// pattern for advertising data change
bool pattern_ble_advertising_step(int *step)
{
	int phase = *step % 20;
	uint32_t duty;

	if (phase < 10) {
		duty = (PWM_PERIOD_USEC * phase) / 10;
	} else {
		duty = (PWM_PERIOD_USEC * (20 - phase)) / 10;
	}

	set_rgb(0, duty, duty); // cyan
	if (*step == 30) {
		pwm_off();
		return false; // done, after 3 seconds
	}
	(*step)++;
	return true;
}

const led_pattern_t PATTERN_BLE_ADVERTISING = {
	.name = "BLE Advertising Updated",
	.step_fn = pattern_ble_advertising_step,
};

// pattern for successful ble connection
bool pattern_ble_connected_step(int *step)
{
	switch (*step) {
	case 0:
		set_rgb(PWM_PERIOD_USEC, 0, 0); // red
		break;
	case 1:
		break;
		set_rgb(0, PWM_PERIOD_USEC, 0); // green
	case 2:
		pwm_off();
		gpio_pin_toggle_dt(&led_1);
		return false; // done
	}
	(*step)++;
	return true;
}

const led_pattern_t PATTERN_BLE_CONNECTED = {
	.name = "BLE Connected",
	.step_fn = pattern_ble_connected_step,
};

// pattern for ble connection failure
static bool pattern_ble_connection_failed_step(int *step)
{
	switch (*step) {
	case 0:
	case 4:
	case 8:
		set_rgb(PWM_PERIOD_USEC, 0, 0); // red on
		break;
	case 2:
	case 6:
	case 10:
		all_off();
		return false; // done
	}
	(*step)++;
	return true;
}

const led_pattern_t PATTERN_BLE_CONNECTION_FAILED = {
	.name = "BLE Connection Failed",
	.step_fn = pattern_ble_connection_failed_step,
};

// pattern for ble disconnection
bool pattern_ble_disconnected_step(int *step)
{
	switch (*step) {
	case 0:
		set_rgb(0, PWM_PERIOD_USEC, 0); // green
		break;
	case 1:
		set_rgb(PWM_PERIOD_USEC, 0, 0); // red
		break;
	case 2:
		all_off();
		return false; // done
	}
	(*step)++;
	return true;
}

const led_pattern_t PATTERN_BLE_DISCONNECTED = {
	.name = "BLE Disconnected",
	.step_fn = pattern_ble_disconnected_step,
};

// pattern for NUS RX received
bool pattern_nus_rx_received_step(int *step)
{
	switch (*step) {
	case 0:
		set_rgb(PWM_PERIOD_USEC, 0, PWM_PERIOD_USEC); // purple
		break;
	case 1:
		pwm_off();
		return false; // done
	}
	(*step)++;
	return true;
}

const led_pattern_t PATTERN_NUS_RX_RECEIVED = {
	.name = "NUS RX Command Received",
	.step_fn = pattern_nus_rx_received_step,
};
```

## src/led.h
```c
/**
 * @file
 * @brief LED controls for the nrf52840 RGB and static green LED.
 *
 * The below table explains the different patterns in more detail.
 *
 * | Pattern                        | Color     | Description                       | Duration  |
 * | ------------------------------ | --------- | --------------------------------- | --------- |
 * | PATTERN_BLE_INIT_FAILED        | Red       | Solid 2s every 5s                 | Forever   |
 * | PATTERN_BLE_ADVERTISING_FAILED | Red       | Two quick flashes, then pause     | Forever   |
 * | PATTERN_COLLECTING_SENSOR      | Yellow    | Pulsing                           | Forever   |
 * | PATTERN_BLE_ADVERTISING        | Cyan      | Smooth fade in/out                | 3 seconds |
 * | PATTERN_BLE_CONNECTED          | Red-Green | Green to red flash transition     | Once      |
 * | PATTERN_BLE_CONNECTION_FAILED  | Red       | Three quick flashes               | Once      |
 * | PATTERN_BLE_DISCONNECTED       | Green→Red | Red to green flash transition     | Once      |
 * | PATTERN_NUS_RX_RECEIVED        | Purple    | Brief blink                       | Once      |
 *
 * NOTE: PATTERN_BLE_CONNECTED will also turn on the static green LED, PATTERN_BLE_DISCONNECTED will
 * turn it off again.
 *
 */

#ifndef LED_H
#define LED_H

#ifdef __cplusplus
extern "C" {
#endif

#include <zephyr/kernel.h>
#include <zephyr/device.h>
#include <zephyr/logging/log.h>
#include <zephyr/drivers/pwm.h>
#include <zephyr/drivers/gpio.h>

#include <stdbool.h>

#define PWM_PERIOD_USEC PWM_USEC(2000)

/**
 * @brief PWM step function to control PWM LED patterns
 * 
 * @return false, if the pattern has completed
 */
typedef bool (*led_pattern_fn_t)(int *step);

typedef struct {
	const char *name;
	led_pattern_fn_t step_fn;
} led_pattern_t;

extern const led_pattern_t PATTERN_BLE_INIT_FAILED;
extern const led_pattern_t PATTERN_BLE_ADVERTISING_FAILED;
extern const led_pattern_t PATTERN_COLLECTING_SENSOR;
extern const led_pattern_t PATTERN_BLE_ADVERTISING;
extern const led_pattern_t PATTERN_BLE_CONNECTED;
extern const led_pattern_t PATTERN_BLE_CONNECTION_FAILED;
extern const led_pattern_t PATTERN_BLE_DISCONNECTED;
extern const led_pattern_t PATTERN_NUS_RX_RECEIVED;

/**
 * @brief init the LEDs. Must be invoked in order to show any patterns
 */
void init_leds(void);

/**
 * @brief set the pattern to be shown.
 *
 * In order to reset the current pattern or turn the LEDs off, invoke with NULL.
 *
 * NOTE: setting a pattern while another one is already running will override it.
 *
 */
void set_led_pattern(const led_pattern_t *pattern);

#ifdef __cplusplus
}
#endif

#endif // LED_H
```

## src/sensors.c
```c
#include "sensors.h"

#include <zephyr/device.h>
#include <zephyr/drivers/sensor.h>

LOG_MODULE_REGISTER(sensors);

static const struct device *const dht22 = DEVICE_DT_GET_ONE(aosong_dht);

void read_sensor_values(measurement_t *measurements)
{

	int error = sensor_sample_fetch(dht22);

	if (error != 0) {
		LOG_ERR("dht sensor sample fetch failed, error: %d", error);
		return;
	}

	struct sensor_value temperature;
	struct sensor_value humidity;

	error = sensor_channel_get(dht22, SENSOR_CHAN_AMBIENT_TEMP, &temperature);
	if (error != 0) {
		LOG_ERR("failed to get dht22 temperature reading, error %d", error);
		measurements->temperature = 0;
	}
	error = sensor_channel_get(dht22, SENSOR_CHAN_HUMIDITY, &humidity);
	if (error != 0) {
		LOG_ERR("failed to get dht22 humidity reading, error %d", error);
		measurements->humidity = 0;
	}
	// convert the sensor value for temperature to a double
	double temp_c = sensor_value_to_double(&temperature);
	// divide the value by 0.005 according to ruuvi requirements
	measurements->temperature = (int16_t)(temp_c / 0.005);
	// convert the sensor value for humidity to a double
	double hum_rh = sensor_value_to_double(&humidity);
	// divide the value by 0.0025 according to ruuvi requirements
	measurements->humidity = (uint16_t)(hum_rh / 0.0025);
}

void init_sensors()
{
	while (!device_is_ready(dht22)) {
		LOG_WRN("device %s is not ready yet, waiting...", dht22->name);
		k_sleep(K_MSEC(100));
	}

	LOG_INF("DHT22 initialized");
}
```

## src/sensors.h
```c
#ifndef SENSORS_H
#define SENSORS_H

#include <zephyr/logging/log.h>
#include <zephyr/random/random.h>

typedef struct {
	int16_t temperature;
	uint16_t humidity;
} measurement_t;

void init_sensors(void);

void read_sensor_values(measurement_t *measurements);

#endif // SENSORS_H
```
